## z/workspace/xzt/conf/bblayers.conf
```bitbake
# POKY_BBLAYERS_CONF_VERSION is increased each time build/conf/bblayers.conf
# changes incompatibly
POKY_BBLAYERS_CONF_VERSION = "2"
RPZY_WORKSPACE = "/mnt/c/work/Favorites/artefacts/Repos/rpzy/z/workspace"
BBPATH = "${TOPDIR}"
BBFILES ?= ""

BBLAYERS ?= " \
  ${RPZY_WORKSPACE}/sources/poky/meta \
  ${RPZY_WORKSPACE}/sources/poky/meta-poky \
  ${RPZY_WORKSPACE}/sources/poky/meta-yocto-bsp \
  ${RPZY_WORKSPACE}/sources/meta-openembedded/meta-oe \
  ${RPZY_WORKSPACE}/sources/meta-openembedded/meta-python \
  ${RPZY_WORKSPACE}/sources/meta-openembedded/meta-networking \
  ${RPZY_WORKSPACE}/sources/meta-openembedded/meta-filesystems \
  ${RPZY_WORKSPACE}/sources/meta-arm/meta-arm \
  ${RPZY_WORKSPACE}/sources/meta-arm/meta-arm-toolchain \
  ${RPZY_WORKSPACE}/sources/meta-xilinx/meta-microblaze \
  ${RPZY_WORKSPACE}/sources/meta-xilinx/meta-xilinx-core \
  ${RPZY_WORKSPACE}/sources/meta-xilinx/meta-xilinx-standalone \
  ${RPZY_WORKSPACE}/sources/meta-xilinx/meta-xilinx-bsp \
  ${RPZY_WORKSPACE}/sources/meta-xilinx/meta-xilinx-vendor \
  ${RPZY_WORKSPACE}/sources/meta-xilinx-tools \
  "
```
